# file: stm32f1xx_tone.ioc
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Mcu.Family=STM32F1
Mcu.Name=STM32F103Z(C-D-E)Tx
Mcu.Package=LQFP144
NVIC.PriorityGroup=NVIC_PRIORITYGROUP_4
NVIC.TIM1_UP_IRQn=true\:0\:0\:false\:false\:true\:true\:true
OSC_IN.Mode=HSE-External-Oscillator
OSC_IN.Signal=RCC_OSC_IN
OSC_OUT.Mode=HSE-External-Oscillator
OSC_OUT.Signal=RCC_OSC_OUT
PA13.Mode=JTAG_5_pins
PA13.Signal=SYS_JTMS-SWDIO
PA14.Mode=JTAG_5_pins
PA14.Signal=SYS_JTCK-SWCLK
PA15.Mode=JTAG_5_pins
PA15.Signal=SYS_JTDI
PB3.Mode=JTAG_5_pins
PB3.Signal=SYS_JTDO-TRACESWO
PB4.Mode=JTAG_5_pins
PB4.Signal=SYS_NJTRST
PB9.GPIO_ModeDefaultOutputPP=GPIO_MODE_OUTPUT_PP
PB9.GPIO_Speed=GPIO_SPEED_FREQ_HIGH
PB9.Signal=GPIO_Output
ProjectManager.HeapSize=0x200
ProjectManager.StackSize=0x400
ProjectManager.TargetToolchain=STM32CubeIDE
RCC.AHBFreq_Value=72000000
RCC.APB1CLKDivider=RCC_HCLK_DIV2
RCC.APB1Freq_Value=36000000
RCC.APB1TimFreq_Value=72000000
RCC.APB2Freq_Value=72000000
RCC.APB2TimFreq_Value=72000000
RCC.HCLKFreq_Value=72000000
RCC.PLLMUL=RCC_PLL_MUL9
RCC.PLLSourceVirtual=RCC_PLLSOURCE_HSE
RCC.SYSCLKFreq_VALUE=72000000
RCC.SYSCLKSource=RCC_SYSCLKSOURCE_PLLCLK
RCC.USBFreq_Value=72000000
VP_TIM1_VS_ClockSourceINT.Mode=Internal
board=custom

// file: Core/Src/main.c
/* USER CODE BEGIN Header */
/**
 ******************************************************************************
 * @file           : main.c
 * @brief          : Main program body
 ******************************************************************************
 * @attention
 *
 * <h2><center>&copy; Copyright (c) 2020 STMicroelectronics.
 * All rights reserved.</center></h2>
 *
 * This software component is licensed by ST under BSD 3-Clause license,
 * the "License"; You may not use this file except in compliance with the
 * License. You may obtain a copy of the License at:
 *                        opensource.org/licenses/BSD-3-Clause
 *
 ******************************************************************************
 */
/* USER CODE END Header */

#include "main.h"

/* USER CODE BEGIN Includes */
#include "tone.h"
#include "pitch.h"
/* USER CODE END Includes */

TIM_HandleTypeDef htim1;

/* USER CODE BEGIN PV */
#define BPM 120 //beat per minute
#define RHYTHEM 4 // use 1/4 note as one beat
const int dpb = 60 * RHYTHEM * 1000 / BPM; // duration per beat

typedef struct {
	uint16_t pitch;
	uint8_t type;   // 4 for quater note, 2 for half note, 1 for whole note etc.
	uint8_t dotted; // 1 for dotted; 0 for none
} Note;

// Note table of Drunken Sailor
// Sheet music here: https://www.8notes.com/scores/11329.asp
Note DrunkenSailor[] = { { NOTE_A5, 4, 0 }, { NOTE_A5, 8, 0 },
		{ NOTE_A5, 8, 0 }, { NOTE_A5, 4, 0 }, { NOTE_A5, 8, 0 },
		{ NOTE_A5, 8, 0 }, { NOTE_A5, 4, 0 }, { NOTE_D5, 4, 0 },
		{ NOTE_F5, 4, 0 }, { NOTE_A5, 4, 0 }, { NOTE_G5, 4, 0 },
		{ NOTE_G5, 8, 0 }, { NOTE_G5, 8, 0 }, { NOTE_G5, 4, 0 },
		{ NOTE_G5, 8, 0 }, { NOTE_G5, 8, 0 }, { NOTE_G5, 4, 0 },
		{ NOTE_C5, 4, 0 }, { NOTE_E5, 4, 0 }, { NOTE_G5, 4, 0 },
		{ NOTE_A5, 4, 0 }, { NOTE_A5, 8, 0 }, { NOTE_A5, 8, 0 },
		{ NOTE_A5, 4, 0 }, { NOTE_A5, 8, 0 }, { NOTE_A5, 8, 0 },
		{ NOTE_A5, 4, 0 }, { NOTE_B5, 4, 0 }, { NOTE_C6, 4, 0 },
		{ NOTE_D6, 4, 0 }, { NOTE_C6, 4, 0 }, { NOTE_A5, 4, 0 },
		{ NOTE_G5, 4, 0 }, { NOTE_E5, 4, 0 }, { NOTE_D5, 2, 0 },
		{ NOTE_D5, 2, 0 }, { NOTE_A5, 2, 0 }, { NOTE_A5, 4, 1 },
		{ NOTE_A5, 8, 0 }, { NOTE_A5, 4, 0 }, { NOTE_D5, 4, 0 },
		{ NOTE_F5, 4, 0 }, { NOTE_A5, 4, 0 }, { NOTE_G5, 2, 0 },
		{ NOTE_G5, 4, 1 }, { NOTE_G5, 8, 0 }, { NOTE_G5, 4, 0 },
		{ NOTE_C5, 4, 0 }, { NOTE_E5, 4, 0 }, { NOTE_G5, 4, 0 },
		{ NOTE_A5, 2, 0 }, { NOTE_A5, 4, 1 }, { NOTE_A5, 8, 0 },
		{ NOTE_A5, 4, 0 }, { NOTE_B5, 4, 0 }, { NOTE_C6, 4, 0 },
		{ NOTE_D6, 4, 0 }, { NOTE_C6, 4, 0 }, { NOTE_A5, 4, 0 },
		{ NOTE_G5, 4, 0 }, { NOTE_E5, 4, 0 }, { NOTE_D5, 2, 0 },
		{ NOTE_D5, 2, 0 } };

/* USER CODE END PV */

void SystemClock_Config(void);
static void MX_GPIO_Init(void);
static void MX_TIM1_Init(void);

int main(void)
{

  /* MCU Configuration--------------------------------------------------------*/

  /* Reset of all peripherals, Initializes the Flash interface and the Systick. */
  HAL_Init();

  /* Configure the system clock */
  SystemClock_Config();

  /* Initialize all configured peripherals */
  MX_GPIO_Init();
  MX_TIM1_Init();
  /* USER CODE BEGIN 2 */

	for (int i = 0; i < sizeof(DrunkenSailor) / sizeof(Note); i++) {
		int duration = dpb * (DrunkenSailor[i].dotted ? 1.5 : 1)
				/ DrunkenSailor[i].type;
		tone(GPIOB, GPIO_PIN_9, DrunkenSailor[i].pitch, duration - 10);
		HAL_Delay(duration + 10);
	}

  /* USER CODE END 2 */

  /* Infinite loop */
  /* USER CODE BEGIN WHILE */
	while (1) {
		//HAL_GPIO_WritePin(GPIOB, GPIO_PIN_9, GPIO_PIN_SET);
		//HAL_Delay(1000);
		//HAL_GPIO_WritePin(GPIOB, GPIO_PIN_9, GPIO_PIN_RESET);
		//HAL_Delay(1000);
    /* USER CODE END WHILE */

	}
}

void SystemClock_Config(void)
{
  RCC_OscInitTypeDef RCC_OscInitStruct = {0};
  RCC_ClkInitTypeDef RCC_ClkInitStruct = {0};

  /** Initializes the CPU, AHB and APB busses clocks
  */
  RCC_OscInitStruct.OscillatorType = RCC_OSCILLATORTYPE_HSE;
  RCC_OscInitStruct.HSEState = RCC_HSE_ON;
  RCC_OscInitStruct.HSEPredivValue = RCC_HSE_PREDIV_DIV1;
  RCC_OscInitStruct.HSIState = RCC_HSI_ON;
  RCC_OscInitStruct.PLL.PLLState = RCC_PLL_ON;
  RCC_OscInitStruct.PLL.PLLSource = RCC_PLLSOURCE_HSE;
  RCC_OscInitStruct.PLL.PLLMUL = RCC_PLL_MUL9;
  if (HAL_RCC_OscConfig(&RCC_OscInitStruct) != HAL_OK)
  {
    Error_Handler();
  }
  /** Initializes the CPU, AHB and APB busses clocks
  */
  RCC_ClkInitStruct.ClockType = RCC_CLOCKTYPE_HCLK|RCC_CLOCKTYPE_SYSCLK
                              |RCC_CLOCKTYPE_PCLK1|RCC_CLOCKTYPE_PCLK2;
  RCC_ClkInitStruct.SYSCLKSource = RCC_SYSCLKSOURCE_PLLCLK;
  RCC_ClkInitStruct.AHBCLKDivider = RCC_SYSCLK_DIV1;
  RCC_ClkInitStruct.APB1CLKDivider = RCC_HCLK_DIV2;
  RCC_ClkInitStruct.APB2CLKDivider = RCC_HCLK_DIV1;

  if (HAL_RCC_ClockConfig(&RCC_ClkInitStruct, FLASH_LATENCY_2) != HAL_OK)
  {
    Error_Handler();
  }
}

static void MX_TIM1_Init(void)
{

  TIM_ClockConfigTypeDef sClockSourceConfig = {0};
  TIM_MasterConfigTypeDef sMasterConfig = {0};

  htim1.Instance = TIM1;
  htim1.Init.Prescaler = 0;
  htim1.Init.CounterMode = TIM_COUNTERMODE_UP;
  htim1.Init.Period = 0;
  htim1.Init.ClockDivision = TIM_CLOCKDIVISION_DIV1;
  htim1.Init.RepetitionCounter = 0;
  htim1.Init.AutoReloadPreload = TIM_AUTORELOAD_PRELOAD_DISABLE;
  if (HAL_TIM_Base_Init(&htim1) != HAL_OK)
  {
    Error_Handler();
  }
  sClockSourceConfig.ClockSource = TIM_CLOCKSOURCE_INTERNAL;
  if (HAL_TIM_ConfigClockSource(&htim1, &sClockSourceConfig) != HAL_OK)
  {
    Error_Handler();
  }
  sMasterConfig.MasterOutputTrigger = TIM_TRGO_RESET;
  sMasterConfig.MasterSlaveMode = TIM_MASTERSLAVEMODE_DISABLE;
  if (HAL_TIMEx_MasterConfigSynchronization(&htim1, &sMasterConfig) != HAL_OK)
  {
    Error_Handler();
  }

}

static void MX_GPIO_Init(void)
{
  GPIO_InitTypeDef GPIO_InitStruct = {0};

  /* GPIO Ports Clock Enable */
  __HAL_RCC_GPIOA_CLK_ENABLE();
  __HAL_RCC_GPIOB_CLK_ENABLE();

  /*Configure GPIO pin Output Level */
  HAL_GPIO_WritePin(GPIOB, GPIO_PIN_9, GPIO_PIN_RESET);

  /*Configure GPIO pin : PB9 */
  GPIO_InitStruct.Pin = GPIO_PIN_9;
  GPIO_InitStruct.Mode = GPIO_MODE_OUTPUT_PP;
  GPIO_InitStruct.Pull = GPIO_NOPULL;
  GPIO_InitStruct.Speed = GPIO_SPEED_FREQ_HIGH;
  HAL_GPIO_Init(GPIOB, &GPIO_InitStruct);

}

void Error_Handler(void)
{
}

/************************ (C) COPYRIGHT STMicroelectronics *****END OF FILE****/
